## config/west.yml
```yaml
manifest:
  remotes:
    - name: zmkfirmware
      url: https://github.com/zmkfirmware/zmk
    # 下記を追加
    - name: petejohanson
      url: https://github.com/petejohanson
  projects:
    - name: zmk
      remote: zmkfirmware
      revision: main
      import: app/west.yml
    # 下記を追加
    - name: zmk-input-processors
      remote: petejohanson
      revision: main
```
